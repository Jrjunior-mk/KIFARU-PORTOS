## firmware/esp32-aux/main/Kconfig.projbuild
```kconfig
menu "KIFARU aux node"

config KIFARU_STATION
    string "Station code"
    default "MARIAKANI"

config KIFARU_LANE
    string "Lane code"
    default "L1"

config KIFARU_WIFI_SSID
    string "Wi-Fi SSID for the MQTT fallback (cabinet AP from the LTE router)"
    default "kifaru-cabinet"

config KIFARU_WIFI_PASS
    string "Wi-Fi password"
    default ""

config KIFARU_MQTT_URI
    string "MQTT broker URI (fallback path, mqtts://host:8883)"
    default "mqtts://192.168.10.1:8883"

config KIFARU_CAN_TX_GPIO
    int "TWAI TX GPIO"
    default 5

config KIFARU_CAN_RX_GPIO
    int "TWAI RX GPIO"
    default 4

config KIFARU_ENV_PERIOD_S
    int "Environment report period (s)"
    default 10

endmenu
```

## firmware/esp32-aux/sdkconfig.defaults
```kconfig
# KIFARU ESP32 aux node — ESP-IDF defaults
CONFIG_IDF_TARGET="esp32"
CONFIG_FREERTOS_HZ=1000
CONFIG_ESP_MAIN_TASK_STACK_SIZE=6144
CONFIG_ESP_TASK_WDT_EN=y
CONFIG_ESP_TASK_WDT_TIMEOUT_S=10
CONFIG_ESP_TASK_WDT_CHECK_IDLE_TASK_CPU0=y
CONFIG_MQTT_PROTOCOL_5=y
CONFIG_MQTT_TRANSPORT_SSL=y
CONFIG_ESP_TLS_USING_MBEDTLS=y
CONFIG_LWIP_SNTP_UPDATE_DELAY=3600000
CONFIG_LOG_DEFAULT_LEVEL_INFO=y
```
